## conf/distro/sharebox.conf
```bitbake
# ShareBox production distro: offline file-sharing box for Raspberry Pi
DISTRO = "sharebox"
DISTRO_NAME = "ShareBox"
DISTRO_VERSION = "0.1.0"
DISTRO_CODENAME = "wrynose"
MAINTAINER = "meta-sharebox maintainers <https://github.com/mgdx/meta-sharebox>"

SDK_VENDOR = "-shareboxsdk"
SDK_VERSION = "${DISTRO_VERSION}"
TARGET_VENDOR = "-sharebox"

require conf/distro/include/sharebox-features.inc
require conf/distro/include/sharebox-security.inc
require conf/distro/include/sharebox-rpi.inc
```

## conf/layer.conf
```bitbake
# meta-sharebox: offline file-sharing box distro and recipes
BBPATH .= ":${LAYERDIR}"

BBFILES += "${LAYERDIR}/recipes-*/*/*.bb \
            ${LAYERDIR}/recipes-*/*/*.bbappend"

BBFILE_COLLECTIONS += "meta-sharebox"
BBFILE_PATTERN_meta-sharebox = "^${LAYERDIR}/"
BBFILE_PRIORITY_meta-sharebox = "10"

LAYERVERSION_meta-sharebox = "1"
LAYERSERIES_COMPAT_meta-sharebox = "wrynose blacksail"

LAYERDEPENDS_meta-sharebox = " \
    core \
    openembedded-layer \
    networking-layer \
    filesystems-layer \
    raspberrypi \
    rauc \
"
LAYERRECOMMENDS_meta-sharebox = "multimedia-layer"

# Only apply bbappends for layers that are actually present
BBFILES_DYNAMIC += " \
    multimedia-layer:${LAYERDIR}/dynamic-layers/multimedia-layer/*/*/*.bb \
    multimedia-layer:${LAYERDIR}/dynamic-layers/multimedia-layer/*/*/*.bbappend \
"
```
